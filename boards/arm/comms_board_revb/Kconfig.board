## boards/arm/comms_board_revb/Kconfig.board
```kconfig
# Copyright (c) 2023 Nordic Semiconductor ASA
# SPDX-License-Identifier: Apache-2.0

config BOARD_COMMS_BOARD_REVB
	bool "comms-board_revB"
	depends on SOC_NRF52840_QIAA
```

## boards/arm/comms_board_revb/Kconfig.defconfig
```kconfig
# Copyright (c) 2023 Nordic Semiconductor ASA
# SPDX-License-Identifier: Apache-2.0

if BOARD_COMMS_BOARD_REVB

config BOARD
	default "comms_board_revb"

config BT_CTLR
   default BT

endif
```

## boards/arm/test_nrf5340_net/Kconfig.board
```kconfig
# Copyright (c) 2023 Nordic Semiconductor ASA
# SPDX-License-Identifier: Apache-2.0

config BOARD_TEST_NRF5340_NET
	bool "test_NRF5340_net"
	depends on SOC_NRF5340_CPUNET_QKAA
```

## boards/arm/test_nrf5340_net/Kconfig.defconfig
```kconfig
# Copyright (c) 2023 Nordic Semiconductor ASA
# SPDX-License-Identifier: Apache-2.0

if BOARD_TEST_NRF5340_NET

config BOARD
	default "test_nrf5340_net"

config BT_CTLR
   default BT

endif
```

## boards/arm/test_nrf5340dk/Kconfig.board
```kconfig
# Copyright (c) 2023 Nordic Semiconductor ASA
# SPDX-License-Identifier: Apache-2.0

config BOARD_TEST_NRF5340DK
	bool "test-NRF5340DK"
	depends on SOC_NRF5340_CPUAPP_QKAA
```

## boards/arm/test_nrf5340dk/Kconfig.defconfig
```kconfig
# Copyright (c) 2023 Nordic Semiconductor ASA
# SPDX-License-Identifier: Apache-2.0

if BOARD_TEST_NRF5340DK

config BOARD
	default "test_nrf5340dk"


endif
```
